## firmware/components/og_common/Kconfig
```kconfig
menu "OpenGauge"
    config OG_ESPNOW_CHANNEL
        int "ESP-NOW Wi-Fi csatorna (mindkét egységen azonos)"
        range 1 13
        default 1
endmenu
```

## firmware/components/og_espnow/Kconfig
```kconfig
menu "OpenGauge: ESP-NOW"
    config OG_ESPNOW_PEER_MAC
        string "A társegység MAC-címe (AA:BB:CC:DD:EE:FF)"
        default "FF:FF:FF:FF:FF:FF"
        help
            Alapértéke a szórási cím: így párosítás nélkül működik, de nincs MAC-szintű
            nyugta és ismétlés. A társ saját címét az indulási napló írja ki.
endmenu
```

## firmware/components/og_twai/Kconfig
```kconfig
menu "OpenGauge: CAN (TWAI)"
    config OG_TWAI_LOG_FRAMES
        bool "Minden CAN-keret naplózása a konzolra (azonosító, DLC, adat)"
        default y
        help
            Teszteléshez hasznos; járműben a sűrű forgalom miatt kikapcsolandó,
            mert a naplózás lassítja a lekérdezési ciklust.
endmenu
```

## firmware/display_node/main/Kconfig.projbuild
```kconfig
menu "OpenGauge: kijelzőegység"

    choice OG_DISP_BOARD
        prompt "Hardverváltozat (lábkiosztás: board_pins.h)"
        default OG_BOARD_DEVKIT_S3
        config OG_BOARD_DEVKIT_S3
            bool "Asztali teszt: Waveshare ESP32-S3-DEV-KIT (N16R8) + 1,85\" modul a 15 pólusú csatlakozón"
        config OG_BOARD_DISP_REV_A
            bool "Saját NYÁK, Rev. A (ESP32-S3-WROOM-1-N8R8, J2 FPC)"
    endchoice

    choice OG_DISP_TEST
        prompt "Futtatott teszt"
        default OG_DISP_TEST_DASH
        config OG_DISP_TEST_DASH
            bool "Műszerfal: valós telemetria ESP-NOW-n, 3 automatikusan váltó képernyő"
        config OG_DISP_TEST_TOUCH
            bool "Érintésteszt: pont az érintés helyén, koordináták, négy célpont, gesztusok"
        config OG_DISP_TEST_LVGL
            bool "LVGL-teszt (M3): ív, felirat, animáció, FPS-mérés"
        config OG_DISP_TEST_COLORS
            bool "Színteszt (M2): egyszínű képek, színsávok, tájolás, átmenetek"
        config OG_DISP_TEST_ESPNOW
            bool "ESP-NOW vétel (M4): telemetria és csomagvesztés naplózása, kijelző nélkül"
    endchoice

    choice OG_LCD_INIT
        prompt "ST77916 init-sorozat"
        default OG_LCD_INIT_WAVESHARE_1_85
        help
            A panel gyári regiszterbeállításai (feszültség, gamma, időzítés) paneltípusonként eltérnek.
        config OG_LCD_INIT_WAVESHARE_1_85
            bool "Waveshare 1,85\" (ESP32_Display_Panel tábla)"
        config OG_LCD_INIT_COMPONENT_DEFAULT
            bool "Az esp_lcd_st77916 komponens alapértelmezett táblája"
    endchoice

    config OG_LCD_PCLK_MHZ
        int "QSPI órajel (MHz)"
        range 5 80
        default 40
        help
            40 MHz-en a Waveshare-modul a devkiten hibátlan (Q-05). Új hardveren (pl. a saját
            NYÁK-on) a színteszttel érdemes 20 MHz-ről indulni.

    config OG_TOUCH_SWAP_XY
        bool "Érintő: X és Y tengely cseréje"
        default n
        help
            Ha az érintés a kijelzőhöz képest 90°-kal elforgatva jelenik meg (az érintésteszt
            célpontjai mutatják), ezzel és a tükrözésekkel igazítható.

    config OG_TOUCH_USE_INT
        bool "Érintő: megszakításvezérelt olvasás (TP_INT)"
        default n
        help
            Kikapcsolva az LVGL időzítve (a frissítési periódussal) kérdezi le az érintőt.
            Bekapcsolva csak a chip megszakítására olvas; a CST816 ritka megszakításai miatt
            így a húzásokból kevés minta jön, és a gesztusok egy része elveszhet.

    config OG_TOUCH_MIRROR_X
        bool "Érintő: X tengely tükrözése"
        default n

    config OG_TOUCH_MIRROR_Y
        bool "Érintő: Y tengely tükrözése"
        default n

    config OG_LCD_SWAP_BYTES
        bool "RGB565 bájtcsere (a panel nagy-endián sorrendet vár)"
        default y

    config OG_LCD_BGR
        bool "BGR színsorrend (ha a piros és a kék fel van cserélve)"
        default n

    config OG_LCD_BACKLIGHT_PERCENT
        int "Háttérvilágítás (%)"
        range 0 100
        default 80

endmenu
```

## firmware/obd_node/main/Kconfig.projbuild
```kconfig
menu "OpenGauge: OBD-egység"

    choice OG_OBD_BOARD
        prompt "Hardverváltozat (lábkiosztás: board_pins.h)"
        default OG_BOARD_DEVKIT_C3
        config OG_BOARD_DEVKIT_C3
            bool "Asztali teszt: ESP32-C3 SuperMini + SN65HVD230 CAN-TTL modul"
        config OG_BOARD_OBD_REV_A
            bool "Saját NYÁK, Rev. A (ESP32-C3-WROOM-02 + SN65HVD231)"
    endchoice

    config OG_OBD_TEST_BLE
        bool "BLE-hirdetési teszt (S-13): csak hirdet, CAN és ESP-NOW nélkül"
        default n
        help
            A CAN-oldal és az ESP-NOW nem indul el; a C3 másodpercenként növekvő számlálóval
            hirdet, a kijelzőegység BLE-tesztje (OG_DISP_TEST_BLE) ezt szkenneli.

    config OG_OBD_BLE_BEACON
        bool "BLE-hirdetés a normál működés mellett (koegzisztencia-teszt, H-16)"
        default n
        depends on !OG_OBD_TEST_BLE

    config OG_OBD_POWER_SAVE
        bool "Alvás: busz-forgalom hiányában light sleep, időzített figyelőablakokkal (S-12)"
        default n
        depends on !OG_OBD_TEST_BLE && !OG_OBD_BLE_BEACON

    config OG_OBD_IDLE_TO_SLEEP_S
        int "Ennyi másodperc csend (nincs ECU-munkamenet és busz-forgalom) után alszik el"
        range 3 600
        default 20
        depends on OG_OBD_POWER_SAVE

    config OG_OBD_SLEEP_GRACE_S
        int "Indulás után ennyi másodpercig nem alszik el (programozás és hibakeresés)"
        range 0 600
        default 60
        depends on OG_OBD_POWER_SAVE
        help
            Light sleep után a C3 USB-s soros/JTAG-kapcsolata nem tér vissza (H-33), és a programozás
            sem megy, amíg a lapkát kézzel újra nem indítjuk. A türelmi idő alatt a lapka programozható.

    config OG_OBD_SLEEP_PERIOD_MS
        int "Az alvási szakaszok hossza (ms): az ébredési késleltetés felső korlátja"
        range 100 10000
        default 1000
        depends on OG_OBD_POWER_SAVE

    config OG_OBD_LISTEN_MS
        int "A figyelőablak hossza (ms)"
        range 10 500
        default 60
        depends on OG_OBD_POWER_SAVE

    config OG_BLE_ADV_INTERVAL_MS
        int "BLE hirdetési periódus (ms)"
        range 20 10240
        default 100
        depends on OG_OBD_TEST_BLE || OG_OBD_BLE_BEACON

endmenu
```

## firmware/tools/ecu_sim/main/Kconfig.projbuild
```kconfig
menu "OpenGauge: ECU-szimulátor"

    choice OG_SIM_BITRATE
        prompt "CAN-sebesség"
        default OG_SIM_BITRATE_500K
        help
            A protokoll-felismerés teszteléséhez a 250 kbit/s is választható.
        config OG_SIM_BITRATE_500K
            bool "500 kbit/s"
        config OG_SIM_BITRATE_250K
            bool "250 kbit/s"
    endchoice

    config OG_SIM_BITRATE_BPS
        int
        default 500000 if OG_SIM_BITRATE_500K
        default 250000 if OG_SIM_BITRATE_250K

    config OG_SIM_EXT_IDS
        bool "29 bites azonosítók (0x18DAF1xx)"
        default n

    config OG_SIM_UDS_ONLY
        bool "OBDonUDS-ECU (J1979-2): csak a 22 F8 10 kérésre válaszol"
        default n
        help
            Azt teszteli, hogy az OBD-egység felismeri és jelzi-e a nem támogatott protokollt.

    config OG_SIM_LATENCY_MS
        int "Az ECU válaszideje (ms)"
        range 1 200
        default 40

    config OG_SIM_DTC_COUNT
        int "Tárolt hibakódok száma (0 = MIL ki)"
        range 0 8
        default 2

endmenu
```
